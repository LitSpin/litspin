## yocto/litbuild/conf/bblayers.conf
```bitbake
# POKY_BBLAYERS_CONF_VERSION is increased each time build/conf/bblayers.conf
# changes incompatibly
POKY_BBLAYERS_CONF_VERSION = "2"

BBPATH = "${TOPDIR}"
BBFILES ?= ""

BBLAYERS ?= " \
  /data/rguilloteau/litspin/yocto/poky/meta \
  /data/rguilloteau/litspin/yocto/poky/meta-poky \
  /data/rguilloteau/litspin/yocto/poky/meta-yocto-bsp \
  /data/rguilloteau/litspin/yocto/meta-litspin \
  /data/rguilloteau/litspin/yocto/meta-openembedded/meta-oe \
  /data/rguilloteau/litspin/yocto/meta-aries \
  "
```

## yocto/meta-litspin/conf/layer.conf
```bitbake
# We have a conf and classes directory, add to BBPATH
BBPATH .= ":${LAYERDIR}"

# We have recipes-* directories, add to BBFILES
BBFILES += "${LAYERDIR}/recipes-*/*/*.bb \
            ${LAYERDIR}/recipes-*/*/*.bbappend"

BBFILE_COLLECTIONS += "meta-litspin"
BBFILE_PATTERN_meta-litspin = "^${LAYERDIR}/"
BBFILE_PRIORITY_meta-litspin = "6"

LAYERDEPENDS_meta-litspin = "core"
LAYERSERIES_COMPAT_meta-litspin = "thud"
```
